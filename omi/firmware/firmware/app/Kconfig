## omi/firmware/firmware/app/Kconfig
```kconfig
source "Kconfig.zephyr"

menu "Omi Features Configuration"

config OMI_CODEC_OPUS
    bool "Opus Audio Codec"
    help
        "Enable the Opus audio codec support."
    default n

config OMI_ENABLE_OFFLINE_STORAGE
	bool "Offline SD Card Storage"
    select DISK_ACCESS
    select FILE_SYSTEM
    select FAT_FILESYSTEM_ELM
    select FS_FATFS_MOUNT_MKFS
    select FS_FATFS_EXFAT
    help
        "Enable the offline storage support. Requires a SD Card."
	default n

# Add support for the filesystem logging backend
config LOG_BACKEND_FS
	bool "File system logging backend"
	depends on LOG
	depends on FILE_SYSTEM
	depends on OMI_ENABLE_OFFLINE_STORAGE
	help
	  When enabled, backend will write log entries to files in the
	  specified location.

config LOG_BACKEND_FS_OVERWRITE
	bool "Old logs overwrite"
	depends on LOG_BACKEND_FS
	default y
	help
	  When enabled, oldest log files will be overwritten when disk is full.

config LOG_BACKEND_FS_FILE_SIZE
	int "Size of a single log file in bytes"
	depends on LOG_BACKEND_FS
	default 16384
	help
	  Maximum size of a log file before a new one is created.

config LOG_BACKEND_FS_DIR
	string "Directory for log files"
	depends on LOG_BACKEND_FS
	default "/SD:/logs"
	help
	  Directory to which log files will be written to.

config OMI_ENABLE_ACCELEROMETER
    bool "Accelerometer Support"
    help
        "Enable the accelerometer support."
    default n

config OMI_ENABLE_BUTTON
    bool "Button support"
    help
        "Enable the software button support."
    default n

config OMI_ENABLE_SPEAKER
    bool "Enable the speaker"
    help
        "Enable the speaker support."
    default n

config OMI_ENABLE_BATTERY
    bool "Enable the battery"
    help
        "Enable the battery support."
    default n

config OMI_ENABLE_USB
    bool "Enable the usb"
    help
        "Enable the USB power check support."
    default n

config OMI_ENABLE_HAPTIC
    bool "Enable the haptic"
    help
        "Enable the haptic support."
    default n

endmenu
```
